## board/braiins/ii1-stm/Kconfig
```kconfig
if TARGET_BRAIINS_II1_STM

config SYS_BOARD
	default "ii1-stm"

config SYS_VENDOR
	default "braiins"

config SYS_CONFIG_NAME
	default "ii1-stm"

source "board/st/common/Kconfig"
endif
```

## board/braiins/stm32mp157c/Kconfig
```kconfig
if TARGET_BRAIINS_STM32MP15_II1

config SYS_BOARD
	default "stm32mp157c"

config SYS_VENDOR
	default "braiins"

config SYS_CONFIG_NAME
	default "stm32mp15_ii1"

endif

if TARGET_BRAIINS_STM32MP15_II2

config SYS_BOARD
	default "stm32mp157c"

config SYS_VENDOR
	default "braiins"

config SYS_CONFIG_NAME
	default "stm32mp15_ii2"

endif

if TARGET_BRAIINS_STM32MP15_II1 || TARGET_BRAIINS_STM32MP15_II2

choice
	prompt "Boot initialization"

config BOOT_INIT_EMMC
	bool "eMMC initialization"

config BOOT_INIT_SD
	bool "SD card initialization"

endchoice

endif
```

## board/braiins/stm32mp15_ii1/Kconfig
```kconfig
if TARGET_BRAIINS_II1_STM

config SYS_BOARD
	default "ii1-stm"

config SYS_VENDOR
	default "braiins"

config SYS_CONFIG_NAME
	default "ii1-stm"

choice
	prompt "Boot initialization"

config BOOT_INIT_EMMC
	bool "eMMC initialization"

config BOOT_INIT_SD
	bool "SD card initialization"

endchoice

endif
```

## configs/stm32mp157c-ii1-am2_p03_a12_sd_defconfig
```kconfig
CONFIG_ARM=y
CONFIG_ARCH_STM32MP=y
CONFIG_TFABOOT=y
CONFIG_SYS_MALLOC_F_LEN=0x3000
CONFIG_ENV_OFFSET=0x680000
CONFIG_TARGET_BRAIINS_STM32MP15_II1=y
CONFIG_CMD_STM32KEY=y
CONFIG_CMD_STM32PROG=y
# CONFIG_CMD_STM32PROG_USB is not set
CONFIG_ENV_OFFSET_REDUND=0x6C0000
CONFIG_BOOT_INIT_SD=y
CONFIG_DEFAULT_DEVICE_TREE="stm32mp157c-ii1-am2_p03_a12"
CONFIG_DISTRO_DEFAULTS=y
CONFIG_FIT=y
CONFIG_BOOTDELAY=1
CONFIG_BOOTCOMMAND="run bootcmd_bos"
CONFIG_SYS_PROMPT="STM32MP> "
# CONFIG_BOOTM_NETBSD is not set
# CONFIG_BOOTM_PLAN9 is not set
# CONFIG_BOOTM_RTEMS is not set
# CONFIG_BOOTM_VXWORKS is not set
# CONFIG_CMD_ELF is not set
CONFIG_CMD_ERASEENV=y
CONFIG_CMD_MEMINFO=y
CONFIG_CMD_MEMTEST=y
CONFIG_SYS_MEMTEST_START=0xc0000000
CONFIG_SYS_MEMTEST_END=0xc4000000
CONFIG_CMD_UNZIP=y
CONFIG_CMD_CLK=y
CONFIG_CMD_FUSE=y
CONFIG_CMD_GPIO=y
CONFIG_CMD_I2C=y
CONFIG_CMD_MMC=y
CONFIG_CMD_REMOTEPROC=y
# CONFIG_CMD_NFS is not set
CONFIG_CMD_DNS=y
CONFIG_CMD_CACHE=y
CONFIG_CMD_TIME=y
CONFIG_CMD_TIMER=y
CONFIG_CMD_PMIC=y
CONFIG_CMD_REGULATOR=y
CONFIG_CMD_EXT4_WRITE=y
CONFIG_CMD_SQUASHFS=y
# CONFIG_ISO_PARTITION is not set
CONFIG_ENV_IS_IN_MMC=y
CONFIG_SYS_REDUNDAND_ENVIRONMENT=y
CONFIG_SYS_RELOC_GD_ENV_ADDR=y
CONFIG_SYS_MMC_ENV_DEV=-1
CONFIG_BUTTON=y
CONFIG_BUTTON_GPIO=y
CONFIG_CLK_SCMI=y
CONFIG_SET_DFU_ALT_INFO=y
CONFIG_GPIO_HOG=y
CONFIG_DM_HWSPINLOCK=y
CONFIG_HWSPINLOCK_STM32=y
CONFIG_DM_I2C=y
CONFIG_SYS_I2C_STM32F7=y
# CONFIG_INPUT is not set
CONFIG_LED=y
CONFIG_LED_GPIO=y
CONFIG_DM_MAILBOX=y
CONFIG_STM32_IPCC=y
CONFIG_STM32_FMC2_EBI=y
CONFIG_DM_MMC=y
CONFIG_SUPPORT_EMMC_BOOT=y
CONFIG_STM32_SDMMC2=y
CONFIG_DM_MTD=y
CONFIG_PHY_SMSC=y
CONFIG_DM_ETH=y
CONFIG_DWC_ETH_QOS=y
CONFIG_PHY=y
CONFIG_PHY_STM32_USBPHYC=y
CONFIG_PINCONF=y
CONFIG_PINCTRL_STMFX=y
CONFIG_DM_PMIC=y
CONFIG_PMIC_STPMIC1=y
CONFIG_DM_REGULATOR=y
CONFIG_DM_REGULATOR_FIXED=y
CONFIG_DM_REGULATOR_GPIO=y
CONFIG_DM_REGULATOR_STM32_VREFBUF=y
CONFIG_DM_REGULATOR_STPMIC1=y
CONFIG_REMOTEPROC_OPTEE=y
CONFIG_REMOTEPROC_STM32_COPRO=y
CONFIG_RESET_SCMI=y
CONFIG_DM_RNG=y
CONFIG_RNG_STM32MP1=y
CONFIG_DM_RTC=y
CONFIG_RTC_STM32=y
CONFIG_SERIAL_RX_BUFFER=y
CONFIG_TEE=y
CONFIG_OPTEE=y
# CONFIG_OPTEE_TA_AVB is not set
CONFIG_DM_VIDEO=y
# CONFIG_BACKLIGHT is not set
# CONFIG_CMD_VIDCONSOLE is not set
# CONFIG_VIDEO_BPP8 is not set
# CONFIG_VIDEO_BPP16 is not set
# CONFIG_VIDEO_BPP32 is not set
# CONFIG_VIDEO_ANSI is not set
# CONFIG_CONSOLE_NORMAL is not set
# CONFIG_PANEL is not set
CONFIG_WDT=y
CONFIG_WDT_STM32MP=y
CONFIG_FAT_WRITE=y
CONFIG_LZO=y
CONFIG_ERRNO_STR=y
CONFIG_HEXDUMP=y
# CONFIG_EFI_LOADER is not set
CONFIG_LMB_RESERVED_REGIONS=16
```
